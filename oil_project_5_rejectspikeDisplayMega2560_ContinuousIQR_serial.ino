#include <SPI.h>
#include <Wire.h>
#include <Adafruit_GFX.h>
#include <Adafruit_ST7789.h>
#include <Adafruit_ADS1X15.h>

// ปุ่มกด
const int switchPinK1 = 2; // Clear / Logo / Continuous (Hold 3s)
const int switchPinK3 = 3; // Calibrate
const int switchPinK2 = 4; // Measure

bool switchK1 = true;
bool switchK2 = true;
bool switchK3 = true;
bool lastswitchK1 = true;
bool lastswitchK2 = true;
bool lastswitchK3 = true;
bool k1ModeBeforePress = false;
bool k1LongPressHandled = false;

// ตัวแปรสำหรับโหมด Continuous
bool isContinuousMode = false;
unsigned long k1PressTime = 0;
unsigned long lastContinuousUpdate = 0;
unsigned long lastRawSerialOutput = 0;

// Adjustable interval for the always-on VPHS/VMAG Serial stream.
const unsigned long SERIAL_OUTPUT_INTERVAL_MS = 1000UL;
const unsigned long SAMPLE_INTERVAL_MS = 1000UL;
const unsigned long K1_LONG_PRESS_MS = 3000UL;

// Adjustable countdown before K3 calibration or K2 measurement starts.
const uint8_t COUNTDOWN_TIME_SECONDS = 30;

// กำหนดขาเชื่อมต่อจอ TFT (ST7789) สำหรับ Arduino Mega2560
#define TFT_CS    10
#define TFT_RST   9
#define TFT_DC    8
Adafruit_ST7789 tft = Adafruit_ST7789(TFT_CS, TFT_DC, TFT_RST);
uint8_t rotation = 3; // แนวนอน (Landscape) 320x240

// ADS1115
Adafruit_ADS1115 ads;

// Adjustable number of samples collected by K3 and K2 (minimum 4 for IQR).
const uint8_t SAMPLE_COUNT = 10;
static_assert(SAMPLE_COUNT >= 4, "SAMPLE_COUNT must be at least 4 for IQR filtering");

float ReferenceVPHS = 0, ReferenceVMAG = 0;
float MeasurementVPHS = 0, MeasurementVMAG = 0;
float VPHSValue[SAMPLE_COUNT];
float VMAGValue[SAMPLE_COUNT];

bool isCalibrated = false; 

// กำหนดค่า Threshold สำหรับ SD แยกอิสระ 2 ค่า
const float SD_THRESHOLD_VPHS = 0.0010;  
const float SD_THRESHOLD_VMAG = 0.0005;  

// =========================================================================================
//  นำรหัส Hex ของโลโก้ NRT จากไฟล์ test_TFT_esp8266_30pin_NRTbitmap.ino มาวางทับตรงนี้ 
// =========================================================================================
const unsigned char epd_bitmap_nrt_logo_top_copy [] PROGMEM = {
  0x00, 0x00, 0x00, 0x00, 0x00, 0x00, 0x00, 0x00, 0x00, 0x00, 0x00, 0x00, 0x00, 0x00, 0x00, 0x00, 
  0x00, 0x00, 0x00, 0x00, 0x00, 0x00, 0x00, 0x00, 0x00, 0x00, 0x00, 0x00, 0x00, 0x00, 0x00, 0x00, 
  0x00, 0x00, 0x00, 0x00, 0x00, 0x00, 0x00, 0x00, 0x00, 0x00, 0x00, 0x00, 0x00, 0x00, 0x00, 0x00, 
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  0x00, 0x00, 0x00, 0x00, 0x00, 0x00, 0x00, 0x00, 0x00, 0x00, 0x00, 0x00, 0x00, 0x00, 0x00, 0x00
};

// =========================================================================================
//  นำรหัส Hex ของโลโก้ RMUTR จากไฟล์ test_TFT_esp8266_30pin_NRTbitmap.ino มาวางทับตรงนี้ 
// =========================================================================================
const unsigned char epd_bitmap_LOGO_RMUTR_ [] PROGMEM = {
  0x00, 0x00, 0x00, 0x00, 0x00, 0x00, 0x00, 0x00, 0x00, 0x00, 0x00, 0x00, 0x00, 0x00, 0x00, 0x00, 
  0x00, 0x00, 0x00, 0x00, 0x00, 0x00, 0x00, 0x00, 0x00, 0x00, 0x00, 0x00, 0x00, 0x00, 0x00, 0x00, 
  0x00, 0x00, 0x00, 0x00, 0x00, 0x00, 0x00, 0x00, 0x00, 0x00, 0x00, 0x00, 0x00, 0x00, 0x00, 0x00, 
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  0x00, 0x00, 0x00, 0x00, 0x00, 0x00, 0x00, 0x00, 0x00, 0x00, 0x00, 0x00, 0x00, 0x00, 0x00, 0x00
};

// ==========================================
// ฟังก์ชันย่อยสำหรับวาด Bitmap (เวอร์ชันเสถียรและเร็วที่สุดสำหรับ Mega2560)
// ==========================================
void drawScaledBitmap(int16_t x, int16_t y, const uint8_t *bitmap, int16_t w, int16_t h, uint16_t color, uint16_t bg, uint8_t scale) {
  int16_t scaledW = w * scale;
  
  // ใช้ Static Buffer (จองแรมตายตัว 512 bytes) ปลอดภัยสุดๆ สำหรับ Mega2560 
  uint16_t lineBuffer[256]; 
  
  int16_t byteWidth = (w + 7) / 8;
  uint8_t byte = 0;
  
  for (int16_t j = 0; j < h; j++) {
    for (int16_t i = 0; i < w; i++) {
      if (i & 7) {
        byte <<= 1;
      } else {
        // ใช้ (uint32_t) ครอบ offset ป้องกัน pointer ทะลุ (Overflow)
        uint32_t offset = (uint32_t)j * byteWidth + (i / 8);
        byte = pgm_read_byte(bitmap + offset);
      }
      
      uint16_t pixelColor = (byte & 0x80) ? color : bg;
      
      for (uint8_t s = 0; s < scale; s++) {
        lineBuffer[i * scale + s] = pixelColor;
      }
    }
    
    // โยนข้อมูลให้จอแสดงผลทีละบรรทัดแนวนอน (เร็วและป้องกันจอภาพกระพริบ)
    for (uint8_t s = 0; s < scale; s++) {
      tft.drawRGBBitmap(x, y + (j * scale) + s, lineBuffer, scaledW, 1);
    }
  }
}

// ==========================================
// Setup
// ==========================================
void setup() {
  Serial.begin(9600);

  pinMode(switchPinK1, INPUT_PULLUP);
  pinMode(switchPinK2, INPUT_PULLUP);
  pinMode(switchPinK3, INPUT_PULLUP);

  // เริ่มต้นจอ TFT ST7789
  tft.init(240, 320); 
  tft.invertDisplay(false); 
  tft.setRotation(rotation);

  // เริ่มต้น ADS1115
  if(!ads.begin(0x48)) {
    Serial.println("ERROR,ADS1115_INIT");
    while(1);
  }

  // Start the new clean Serial protocol immediately after ADS1115 is ready.
  outputRawSerialSample("DATA");

  // แอนิเมชันเปิดเครื่อง โชว์ 2 โลโก้สลับกัน
  tft.fillScreen(ST77XX_BLACK);
  drawScaledBitmap(32, 56, epd_bitmap_nrt_logo_top_copy, 128, 64, tft.color565(0, 255, 0), ST77XX_BLACK, 2);
  waitWithSerialOutput(1500);
  tft.fillScreen(ST77XX_BLACK);
  drawScaledBitmap(32, 56, epd_bitmap_LOGO_RMUTR_, 128, 64, tft.color565(255, 0, 0), ST77XX_BLACK, 2);
  waitWithSerialOutput(1500);
  
  // ค้างไว้ที่โลโก้ NRT พร้อมรอคำสั่ง
  showLogo();
}

// ==========================================
// Loop
// ==========================================
void loop() {
  switchK1 = digitalRead(switchPinK1);
  switchK2 = digitalRead(switchPinK2);
  switchK3 = digitalRead(switchPinK3);
  serviceRawSerialOutput();

  // === จัดการปุ่ม K1 (สลับโหมด Continuous / Single / Clear Screen) ===
  if (switchK1 == LOW && lastswitchK1 == HIGH) { 
    k1PressTime = millis();
    k1ModeBeforePress = isContinuousMode;
    k1LongPressHandled = false;
  }
  
  if (switchK1 == LOW && lastswitchK1 == LOW) { 
    // กำลังกดค้างอยู่ เช็คว่าถึง 3 วินาที (3000ms) หรือยัง
    if (!k1LongPressHandled && millis() - k1PressTime >= K1_LONG_PRESS_MS) {
      k1LongPressHandled = true;
      isContinuousMode = !k1ModeBeforePress; // Toggle from the mode before K1 was pressed.
      
      if (isContinuousMode) {
        // แสดง Splash Screen ก่อนเข้าโหมด Continuous
        tft.fillScreen(ST77XX_BLACK);
        tft.setTextColor(ST77XX_YELLOW);
        tft.setTextSize(4);
        const char* msg1 = "CONTINUOUS";
        const char* msg2 = "MODE";
        tft.setCursor((320 - strlen(msg1)*24)/2, 90); tft.print(msg1);
        tft.setCursor((320 - strlen(msg2)*24)/2, 130); tft.print(msg2);
        
        waitWithSerialOutput(2000);
        drawContinuousLayout();

        lastContinuousUpdate = millis();
      } else {
        // แสดง Splash Screen ก่อนกลับเข้าโหมด Single
        tft.fillScreen(ST77XX_BLACK);
        tft.setTextColor(ST77XX_GREEN);
        tft.setTextSize(4);
        const char* msg1 = "SINGLE";
        const char* msg2 = "MODE";
        tft.setCursor((320 - strlen(msg1)*24)/2, 90); tft.print(msg1);
        tft.setCursor((320 - strlen(msg2)*24)/2, 130); tft.print(msg2);
        
        waitWithSerialOutput(2000);
        showLogo();
      }
      
      // รอจนกว่าจะปล่อยปุ่ม เพื่อป้องกันการสลับโหมดซ้ำๆ ทันที
      while(digitalRead(switchPinK1) == LOW) {
        serviceRawSerialOutput();
        delay(10);
      }
      switchK1 = HIGH; // รีเซ็ตสถานะปุ่ม
      lastswitchK1 = HIGH; // <--- เพิ่มบรรทัดนี้ เพื่อบอกระบบว่าเคลียร์การกดปุ่มแล้ว จะได้ไม่ไปทริกเกอร์กดสั้นซ้ำ!
      k1PressTime = millis();
    }
  }

  if (switchK1 == HIGH && lastswitchK1 == LOW) {
    // A short K1 press clears only in Single mode. A long press has already
    // been handled above and must never clear calibration data.
    if (!k1LongPressHandled && !k1ModeBeforePress) {
      clearAllMeasurementData();
      showLogo();
    }
  }

  lastswitchK1 = switchK1;

  // === จัดการปุ่ม K2 และ K3 (ให้ทำงานเฉพาะโหมด Single เท่านั้น) ===
  if (!isContinuousMode && switchK1 == HIGH) {
    // K3 → Calibrate
    if(switchK3 != lastswitchK3 && switchK3 == LOW) {
      outputRawSerialSample("K3_PRESS");
      calibrateReference();
    }
    lastswitchK3 = switchK3;

    // K2 → Measure
    if(switchK2 != lastswitchK2 && switchK2 == LOW) {
      takeMeasurement();
    }
    lastswitchK2 = switchK2;

  }

  // === อัปเดตการแสดงผลในโหมด Continuous (ทุก 50ms) ===
  if (isContinuousMode) {
    if (millis() - lastContinuousUpdate >= 50) {
      lastContinuousUpdate = millis();
      
      // อ่านค่าดิบ
      int16_t adc0 = ads.readADC_SingleEnded(0);
      int16_t adc1 = ads.readADC_SingleEnded(1);
      float rawVPHS = adc0 * 0.1875 / 1000.0;
      float rawVMAG = adc1 * 0.1875 / 1000.0;

      // เซ็ตฟอนต์และการวาดทับสีพื้นหลัง (ลบเลขเก่าอัตโนมัติ ไม่จอกะพริบ)
      tft.setTextSize(4);
      tft.setTextColor(ST77XX_WHITE, ST77XX_BLACK); 

      // แปลงเป็น String แบบระบุความกว้าง (7 ตัวอักษร) เพื่อให้ถมสีดำทับของเดิมได้สนิท
      char vphsStr[10];
      dtostrf(rawVPHS, 7, 3, vphsStr); 
      tft.setCursor(15, 80);
      tft.print(vphsStr);

      char vmagStr[10];
      dtostrf(rawVMAG, 7, 3, vmagStr);
      tft.setCursor(15, 175);
      tft.print(vmagStr);

    }
  }

  delay(10); // หน่วงเวลาเล็กน้อยเพื่อ Debounce ปุ่ม
}

// ==========================================
// ฟังก์ชันการทำงานหลัก
// ==========================================
void showLogo() {
  tft.fillScreen(ST77XX_BLACK);
  // ขนาดโลโก้ 128x64 คูณ 2 เท่า = 256x128 จัดให้อยู่กึ่งกลางจอ (320x240)
  drawScaledBitmap(32, 56, epd_bitmap_nrt_logo_top_copy, 128, 64, tft.color565(0, 255, 0), ST77XX_BLACK, 2);
}

void clearAllMeasurementData() {
  isCalibrated = false;
  ReferenceVPHS = 0.0;
  ReferenceVMAG = 0.0;
  MeasurementVPHS = 0.0;
  MeasurementVMAG = 0.0;

  for (int i = 0; i < SAMPLE_COUNT; i++) {
    VPHSValue[i] = 0.0;
    VMAGValue[i] = 0.0;
  }
}

void outputRawSerialSample(const char* recordType) {
  int16_t adc0 = ads.readADC_SingleEnded(0);
  int16_t adc1 = ads.readADC_SingleEnded(1);
  float rawVPHS = adc0 * 0.1875 / 1000.0;
  float rawVMAG = adc1 * 0.1875 / 1000.0;

  Serial.print(recordType);
  Serial.print(',');
  Serial.print(millis());
  Serial.print(',');
  Serial.print(rawVPHS, 3);
  Serial.print(',');
  Serial.println(rawVMAG, 3);
  lastRawSerialOutput = millis();
}

void outputCalculatedCalibrationStamp() {
  Serial.print("K3_CAL,");
  Serial.print(millis());
  Serial.print(',');
  Serial.print(ReferenceVPHS, 3);
  Serial.print(',');
  Serial.println(ReferenceVMAG, 3);
}

void outputCollectedSample(const char* recordType, int sampleNumber, float vphs, float vmag) {
  Serial.print(recordType);
  Serial.print(',');
  Serial.print(millis());
  Serial.print(',');
  Serial.print(sampleNumber);
  Serial.print(',');
  Serial.print(vphs, 3);
  Serial.print(',');
  Serial.println(vmag, 3);
}

void serviceRawSerialOutput() {
  if (millis() - lastRawSerialOutput >= SERIAL_OUTPUT_INTERVAL_MS) {
    outputRawSerialSample("DATA");
  }
}

void waitWithSerialOutput(unsigned long durationMs) {
  unsigned long waitStarted = millis();
  while (millis() - waitStarted < durationMs) {
    serviceRawSerialOutput();
    delay(10);
  }
}

bool abortIfK1Pressed() {
  if (digitalRead(switchPinK1) != LOW) {
    return false;
  }

  // Abort the current K2/K3 operation immediately, then classify this K1
  // action as a short press or a 3-second hold before changing stored data.
  unsigned long blockingPressStarted = millis();
  while (digitalRead(switchPinK1) == LOW &&
         millis() - blockingPressStarted < K1_LONG_PRESS_MS) {
    delay(10);
  }

  if (digitalRead(switchPinK1) == LOW) {
    // Long K1 hold from Single mode: enter Continuous and preserve Cal/Mea.
    isContinuousMode = true;
    tft.fillScreen(ST77XX_BLACK);
    tft.setTextColor(ST77XX_YELLOW);
    tft.setTextSize(4);
    const char* msg1 = "CONTINUOUS";
    const char* msg2 = "MODE";
    tft.setCursor((320 - strlen(msg1) * 24) / 2, 90);
    tft.print(msg1);
    tft.setCursor((320 - strlen(msg2) * 24) / 2, 130);
    tft.print(msg2);
    waitWithSerialOutput(2000);
    drawContinuousLayout();

    lastContinuousUpdate = millis();

    while (digitalRead(switchPinK1) == LOW) {
      serviceRawSerialOutput();
      delay(10);
    }
  } else {
    // Short K1 press from Single mode: clear all stored measurement data.
    clearAllMeasurementData();
    showLogo();
  }

  switchK1 = HIGH;
  lastswitchK1 = HIGH;
  lastswitchK2 = digitalRead(switchPinK2);
  lastswitchK3 = digitalRead(switchPinK3);
  k1ModeBeforePress = isContinuousMode;
  k1LongPressHandled = true;
  k1PressTime = millis();
  return true;
}

bool waitWithK1Priority(unsigned long durationMs) {
  unsigned long waitStarted = millis();
  while (millis() - waitStarted < durationMs) {
    serviceRawSerialOutput();
    if (abortIfK1Pressed()) {
      return false;
    }
    delay(10);
  }
  return true;
}

// ฟังก์ชันวาดหน้า Layout เปล่าๆ สำหรับโหมด Continuous
void drawContinuousLayout() {
  tft.fillScreen(ST77XX_BLACK);
  
  // หัวข้อกึ่งกลาง
  tft.setTextSize(2);
  tft.setTextColor(ST77XX_WHITE);
  const char* title = "--- CONTINUOUS ---";
  int titleX = (320 - (strlen(title) * 12)) / 2;
  tft.setCursor(titleX, 10);
  tft.print(title);

  int leftMargin = 15; 

  // หัวข้อ VPHS
  tft.setTextSize(3);
  tft.setTextColor(ST77XX_YELLOW);
  tft.setCursor(leftMargin, 45);
  tft.print("RAW VPHS");

  // หัวข้อ VMAG
  tft.setTextColor(ST77XX_YELLOW);
  tft.setCursor(leftMargin, 140);
  tft.print("RAW VMAG");
}

// ฟังก์ชันจัดการข้อมูล (กรอง Outlier ด้วย IQR, หา Mean และ SD)
void processDataWithIQR(float data[], int size, float &outMean, float &outSD, int &outValidCount) {
  // 1. สร้าง Array สำรองเพื่อเรียงลำดับข้อมูล
  float sortedData[SAMPLE_COUNT];
  for (int i = 0; i < size; i++) {
    sortedData[i] = data[i];
  }

  // 2. เรียงลำดับข้อมูลจากน้อยไปมาก (ใช้ Bubble Sort สำหรับข้อมูลจำนวนน้อย)
  for (int i = 0; i < size - 1; i++) {
    for (int j = 0; j < size - i - 1; j++) {
      if (sortedData[j] > sortedData[j + 1]) {
        float temp = sortedData[j];
        sortedData[j] = sortedData[j + 1];
        sortedData[j + 1] = temp;
      }
    }
  }

  // 3. หา Q1, Q3 และ IQR
  float q1 = sortedData[size / 4];
  float q3 = sortedData[(size * 3) / 4];
  float iqr = q3 - q1;

  float lowerBound = q1 - (1.5 * iqr);
  float upperBound = q3 + (1.5 * iqr);

  // 4. กรอง Outlier และหาค่า Mean ของชุดข้อมูลที่สะอาดแล้ว
  float sum = 0.0;
  int validCount = 0;
  for (int i = 0; i < size; i++) {
    if (data[i] >= lowerBound && data[i] <= upperBound) {
      sum += data[i];
      validCount++;
    }
  }

  if (validCount > 0) {
    outMean = sum / validCount;
  } else {
    outMean = 0.0; // ป้องกันการหาร 0
  }

  // 5. หาค่า SD จากชุดข้อมูลที่กรองแล้ว
  float sumDev = 0.0;
  if (validCount > 0) {
    for (int i = 0; i < size; i++) {
      if (data[i] >= lowerBound && data[i] <= upperBound) {
        sumDev += pow(data[i] - outMean, 2);
      }
    }
    outSD = sqrt(sumDev / validCount);
  } else {
    outSD = 9999.0; // หากข้อมูลโดนตัดหมด บังคับให้ SD สูงเพื่อให้ติด Error
  }
  
  outValidCount = validCount;
}

void calibrateReference() {
  if (!showSaturationCountdown("K3", ST77XX_YELLOW)) {
    return;
  }
  showAnimation("Calibrating..."); 

  // Collect saturated samples at the configured interval.
  for(int i=0;i<SAMPLE_COUNT;i++){
    if (!waitWithK1Priority(SAMPLE_INTERVAL_MS)) {
      return;
    }
    int16_t adc0 = ads.readADC_SingleEnded(0);
    int16_t adc1 = ads.readADC_SingleEnded(1);
    float v0 = adc0*0.1875/1000;
    float v1 = adc1*0.1875/1000;
    VPHSValue[i] = v0;
    VMAGValue[i] = v1;
    outputCollectedSample("K3_SAMPLE", i + 1, v0, v1);

    updateSamplingProgress(i + 1, ST77XX_YELLOW);
  }

  float sdVPHS, sdVMAG;
  int validVPHS, validVMAG;
  
  // 2-6. กรอง IQR และคำนวณสถิติ
  processDataWithIQR(VPHSValue, SAMPLE_COUNT, ReferenceVPHS, sdVPHS, validVPHS);
  processDataWithIQR(VMAGValue, SAMPLE_COUNT, ReferenceVMAG, sdVMAG, validVMAG);

  if (sdVPHS >= (SD_THRESHOLD_VPHS - 0.00001) || sdVMAG >= (SD_THRESHOLD_VMAG - 0.00001)) {
    isCalibrated = false; 
    showErrorScreen("CALIBRATE", sdVPHS, sdVMAG);

  } else {
    isCalibrated = true; 
    showMeasurementResult("--- CALIBRATION ---", "Cal VPHS", ReferenceVPHS, sdVPHS, "Cal VMAG", ReferenceVMAG, sdVMAG, tft.color565(255, 255, 0));
    outputCalculatedCalibrationStamp();
  }
}

void takeMeasurement() {
  if (!isCalibrated) {
    showNotCalibratedScreen(); 
    return; 
  }

  if (!showSaturationCountdown("K2", ST77XX_GREEN)) {
    return;
  }
  showAnimation("Measuring..."); 

  // Collect saturated samples at the configured interval.
  for(int i=0;i<SAMPLE_COUNT;i++){
    if (!waitWithK1Priority(SAMPLE_INTERVAL_MS)) {
      return;
    }
    int16_t adc0 = ads.readADC_SingleEnded(0);
    int16_t adc1 = ads.readADC_SingleEnded(1);
    float v0 = adc0*0.1875/1000;
    float v1 = adc1*0.1875/1000;
    VPHSValue[i] = v0;
    VMAGValue[i] = v1;

    updateSamplingProgress(i + 1, ST77XX_GREEN);
  }

  float sdVPHS, sdVMAG;
  int validVPHS, validVMAG;
  
  // 2-6. กรอง IQR และคำนวณสถิติ
  processDataWithIQR(VPHSValue, SAMPLE_COUNT, MeasurementVPHS, sdVPHS, validVPHS);
  processDataWithIQR(VMAGValue, SAMPLE_COUNT, MeasurementVMAG, sdVMAG, validVMAG);

  float RealVPHS = ReferenceVPHS - MeasurementVPHS;
  float RealVMAG = ReferenceVMAG - MeasurementVMAG;

  if (sdVPHS >= (SD_THRESHOLD_VPHS - 0.00001) || sdVMAG >= (SD_THRESHOLD_VMAG - 0.00001)) {
    showErrorScreen("MEASURE", sdVPHS, sdVMAG);
  } else {
    showMeasurementResult("--- MEASUREMENT ---", "Mea VPHS", RealVPHS, sdVPHS, "Mea VMAG", RealVMAG, sdVMAG, tft.color565(0, 255, 0));
  }
}

// ==========================================
// ฟังก์ชันจัดการ UI และ แอนิเมชันสำหรับจอ TFT
// ==========================================
bool showSaturationCountdown(const char* action, uint16_t mainColor) {
  tft.fillScreen(ST77XX_BLACK);

  const char* title = "Preparing...";
  tft.setTextSize(3);
  tft.setTextColor(ST77XX_WHITE);
  tft.setCursor((320 - strlen(title) * 18) / 2, 50);
  tft.print(title);

  const char* warning = "DO NOT OPEN!";
  tft.setTextSize(3);
  tft.setTextColor(mainColor);
  tft.setCursor((320 - strlen(warning) * 18) / 2, 165);
  tft.print(warning);

  for (int remaining = COUNTDOWN_TIME_SECONDS; remaining > 0; remaining--) {
    tft.fillRect(55, 75, 210, 65, ST77XX_BLACK);
    tft.setTextSize(5);
    tft.setTextColor(ST77XX_WHITE);

    char countdownText[8];
    snprintf(countdownText, sizeof(countdownText), "%d", remaining);
    tft.setCursor((320 - strlen(countdownText) * 30) / 2, 100);
    tft.print(countdownText);

    if (!waitWithK1Priority(1000)) {
      return false;
    }
  }
  return true;
}

void showAnimation(const char* text) {
  tft.fillScreen(ST77XX_BLACK);

  tft.setTextColor(ST77XX_WHITE);
  tft.setTextSize(3);
  int textLen = strlen(text);
  int textX = (320 - (textLen * 18)) / 2;
  tft.setCursor(textX, 50);
  tft.print(text);

  // Empty horizontal progress bar. It is filled by each real sensor sample.
  tft.drawRect(29, 109, 262, 32, ST77XX_WHITE);
  tft.fillRect(30, 110, 260, 30, ST77XX_BLACK);
  updateSamplingProgress(0, ST77XX_BLACK);
}

void updateSamplingProgress(int completedSamples, uint16_t mainColor) {
  if (completedSamples < 0) completedSamples = 0;
  if (completedSamples > SAMPLE_COUNT) completedSamples = SAMPLE_COUNT;

  const int barX = 30;
  const int barY = 110;
  const int barWidth = 260;
  const int barHeight = 30;
  int filledWidth = (barWidth * completedSamples) / SAMPLE_COUNT;
  int percent = (100 * completedSamples) / SAMPLE_COUNT;

  tft.fillRect(barX, barY, barWidth, barHeight, ST77XX_BLACK);
  if (filledWidth > 0) {
    tft.fillRect(barX, barY, filledWidth, barHeight, mainColor); //สีหลอด
  }

  char percentText[6];
  snprintf(percentText, sizeof(percentText), "%d%%", percent);

  tft.fillRect(0, 160, 320, 28, ST77XX_BLACK);
  tft.setTextSize(3);
  tft.setTextColor(ST77XX_WHITE);
  tft.setCursor((320 - strlen(percentText) * 18) / 2, 165);
  tft.print(percentText);

  // char samplesText[18];
  // snprintf(samplesText, sizeof(samplesText), "Samples %d/%d", completedSamples, SAMPLE_COUNT);

  // tft.fillRect(0, 190, 320, 28, ST77XX_BLACK);
  // tft.setTextSize(2);
  // tft.setTextColor(ST77XX_CYAN);
  // tft.setCursor((320 - strlen(samplesText) * 12) / 2, 195);
  // tft.print(samplesText);
}

void showMeasurementResult(const char* title, const char* label1, float val1, float sd1, const char* label2, float val2, float sd2, uint16_t mainColor) {
  tft.fillScreen(ST77XX_BLACK);
  
  tft.setTextSize(2);
  tft.setTextColor(ST77XX_WHITE);
  int titleLen = strlen(title);
  int titleWidth = titleLen * 12; 
  int titleX = (320 - titleWidth) / 2;
  tft.setCursor(titleX, 10);
  tft.print(title);

  int leftMargin = 15; 
  int rightCol = 190; 

  tft.setTextSize(3);
  tft.setTextColor(mainColor);
  tft.setCursor(leftMargin, 45);
  tft.print(label1);
  
  tft.setTextSize(2);
  tft.setTextColor(ST77XX_CYAN);
  tft.setCursor(rightCol, 53); 
  tft.print("SD VPHS");

  tft.setTextSize(4);
  tft.setTextColor(ST77XX_WHITE);
  tft.setCursor(leftMargin, 80);
  tft.print(val1, 3);
  
  tft.setTextSize(3);
  tft.setTextColor(ST77XX_CYAN);
  tft.setCursor(rightCol, 87);
  tft.print(sd1, 4);

  tft.setTextSize(3);
  tft.setTextColor(mainColor);
  tft.setCursor(leftMargin, 140);
  tft.print(label2);
  
  tft.setTextSize(2);
  tft.setTextColor(ST77XX_CYAN);
  tft.setCursor(rightCol, 148);
  tft.print("SD VMAG");

  tft.setTextSize(4);
  tft.setTextColor(ST77XX_WHITE);
  tft.setCursor(leftMargin, 175);
  tft.print(val2, 3);
  
  tft.setTextSize(3);
  tft.setTextColor(ST77XX_CYAN);
  tft.setCursor(rightCol, 182);
  tft.print(sd2, 4);
}

void showErrorScreen(const char* action, float sd1, float sd2) {
  tft.fillScreen(ST77XX_BLACK);
  
  tft.setTextSize(3);
  tft.setTextColor(ST77XX_RED);
  const char* title = "HIGH SD ERROR!";
  int titleX = (320 - (strlen(title) * 18)) / 2;
  tft.setCursor(titleX, 20);
  tft.print(title);

  char sd1Str[10];
  dtostrf(sd1, 6, 4, sd1Str);
  char textVPHS[30];
  sprintf(textVPHS, "SD VPHS: %s", sd1Str);
  
  tft.setTextSize(3);
  tft.setTextColor(ST77XX_CYAN);
  int vphsX = (320 - (strlen(textVPHS) * 18)) / 2;
  tft.setCursor(vphsX, 75);
  tft.print(textVPHS);

  char sd2Str[10];
  dtostrf(sd2, 6, 4, sd2Str);
  char textVMAG[30];
  sprintf(textVMAG, "SD VMAG: %s", sd2Str);
  
  int vmagX = (320 - (strlen(textVMAG) * 18)) / 2;
  tft.setCursor(vmagX, 125);
  tft.print(textVMAG);

  char textRetry[30];
  sprintf(textRetry, "RETRY %s", action);
  tft.setTextColor(ST77XX_YELLOW);
  int retryX = (320 - (strlen(textRetry) * 18)) / 2;
  tft.setCursor(retryX, 190);
  tft.print(textRetry);
}

void showNotCalibratedScreen() {
  tft.fillScreen(ST77XX_BLACK);
  
  tft.setTextSize(4);
  tft.setTextColor(ST77XX_RED);
  const char* title = "WARNING!";
  int titleX = (320 - (strlen(title) * 24)) / 2; 
  tft.setCursor(titleX, 50);
  tft.print(title);

  tft.setTextSize(3);
  tft.setTextColor(ST77XX_YELLOW);
  const char* msg1 = "PLEASE CALIBRATE";
  int msg1X = (320 - (strlen(msg1) * 18)) / 2; 
  tft.setCursor(msg1X, 110);
  tft.print(msg1);

  const char* msg2 = "BEFORE MEASURING";
  int msg2X = (320 - (strlen(msg2) * 18)) / 2; 
  tft.setCursor(msg2X, 160);
  tft.print(msg2);
}
